## tests/results/2026-11-24T132532Z-unit/genconfig_test/kconfig_minimal/minimal_defconfig
```kconfig
CONFIG_AUDIO=y
CONFIG_AUDIO_CORE_MELODEE=y
CONFIG_EFFECTS_MELODEE=y
# CONFIG_INPUT is not set
# CONFIG_FLASH is not set
# CONFIG_MIDI_UART is not set
# CONFIG_DUAL_CORE is not set
CONFIG_USB=y
```
