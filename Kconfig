## Kconfig
```kconfig
mainmenu "modd Firmware Configuration"

config FIRMWARE_NAME
    string "Firmware name"
    default "modd"

config FIRMWARE_VERSION
    string "Firmware version"
    default "v0.0.0"

source "kconf/engines.kconfig"
source "kconf/effects.kconfig"
source "kconf/sequencer.kconfig"
source "kconf/scales.kconfig"

menu "System"

source "kconf/hal.kconfig"
source "kconf/boot.kconfig"
source "kconf/audio.kconfig"
source "kconf/core.kconfig"
source "kconf/midi.kconfig"
source "kconf/ui.kconfig"
source "kconf/storage.kconfig"
source "kconf/flash.kconfig"
source "kconf/memory.kconfig"
source "kconf/udisk.kconfig"
source "kconf/dock.kconfig"
source "kconf/ble.kconfig"
source "kconf/net.kconfig"
source "kconf/wifi.kconfig"
source "kconf/rpc.kconfig"
source "kconf/debug.kconfig"
source "kconf/sys_menu.kconfig"
source "kconf/sched.kconfig"

endmenu
```

## configs/modd_emu_defconfig
```kconfig
# modd_emu: an emulator build, never flashed (tools/device/fm1_install.py refuses any
# CONFIG_EMU package). modd_defconfig plus the emulator memory map (CONFIG_EMU: a 464 KiB
# pool, the FM-1 has 336 KiB), the shadow framebuffer for /api/screenshot, the REST API's
# input, memory and audio-tap routes, the emulator's test WiFi network, and the weather
# page with a fixed location (New York, api.open-meteo.com). The direct-API tests run on it
# in fm1-live (task test:api = task modd:test:modd_emu:api). Keep in step with modd_defconfig.
#
CONFIG_EMU=y (expanded POOL
# linker script), CONFIG_DEBUG_FRAMEBUFFER=y, and USB ethernet auto-connect
# so the emulator's --usb ethernet link brings up lwIP without a menu visit.
CONFIG_EMU=y
CONFIG_FIRMWARE_NAME="modd"
CONFIG_FIRMWARE_VERSION="v0.0.0"

#
# Engines
#
CONFIG_ENGINES=y

#
# Multi-upstream (require full audio core)
#
CONFIG_ENGINE_FM6=y
CONFIG_ENGINE_FM6_FMLAB=y
# CONFIG_ENGINE_FM6_FELUCCA is not set
# CONFIG_ENGINE_FM6_MELODEE is not set
# CONFIG_ENGINE_DRUM is not set

#
# Melodee
#
# CONFIG_ENGINE_PROPHET is not set
# CONFIG_ENGINE_CZ1 is not set
# CONFIG_ENGINE_SID is not set

#
# Felucca (MIT)
#
CONFIG_ENGINE_ANALOG=y
# CONFIG_ENGINE_DIGITAL is not set
# CONFIG_ENGINE_PHASE is not set
# CONFIG_ENGINE_SAMPLE is not set
# CONFIG_ENGINE_GRANULAR is not set
CONFIG_ENGINE_LOFI=y
CONFIG_ENGINE_TRIO=y
# CONFIG_ENGINE_TONEWHEEL is not set
# CONFIG_ENGINE_FORMANT is not set
# CONFIG_ENGINE_PHYSICAL is not set
CONFIG_ENGINE_NOISE=y

#
# Development
#
CONFIG_ENGINE_STUB=y
# end of Engines

#
# Effects
#
# CONFIG_EFFECTS_FELUCCA is not set
# CONFIG_EFFECTS_SLOOP is not set
CONFIG_EFFECTS_MELODEE=y
CONFIG_FX_HOST=y
CONFIG_FX_UNIT_SLOOP_INSERT=y
CONFIG_FX_UNIT_EXGAIN=y
CONFIG_ARENA_MELODEE=y
CONFIG_MODULATION=y
CONFIG_MOD_MELODEE=y
# CONFIG_MIX is not set
# end of Effects

#
# Sequencer
#
CONFIG_SEQ_FELUCCA=y
# CONFIG_SEQ_SLOOP is not set
# end of Sequencer

#
# Scales
#
# CONFIG_SCALES_FELUCCA is not set
CONFIG_SCALES_MELODEE=y
# end of Scales

#
# System
#

#
# HAL
#

#
# Always included: fm1_adc.h, fm1_cc.h, fm1_gpio.h, fm1_xip.h, fm1_time.h
#
# CONFIG_HAL_SYS_FELUCCA is not set
# CONFIG_HAL_SYS_SLOOP is not set
CONFIG_HAL_SYS_MELODEE=y
# CONFIG_HAL_IRQ_FELUCCA is not set
# CONFIG_HAL_IRQ_SLOOP is not set
CONFIG_HAL_IRQ_MELODEE=y
# CONFIG_HAL_LCD_FELUCCA is not set
CONFIG_HAL_LCD_MELODEE=y
# CONFIG_HAL_INPUT_FELUCCA is not set
# CONFIG_HAL_INPUT_SLOOP is not set
CONFIG_HAL_INPUT_MELODEE=y
# CONFIG_HAL_GUARD_FELUCCA is not set
# CONFIG_HAL_GUARD_SLOOP is not set
CONFIG_HAL_GUARD_MELODEE=y
# CONFIG_HAL_FLASH_FELUCCA is not set
# CONFIG_HAL_FLASH_SLOOP is not set
CONFIG_HAL_FLASH_MELODEE=y
# CONFIG_HAL_UART_FELUCCA is not set
CONFIG_HAL_UART_MELODEE=y
# CONFIG_HAL_USB_FELUCCA is not set
CONFIG_HAL_USB_MELODEE=y
# CONFIG_HAL_TIMER_FELUCCA is not set
CONFIG_HAL_TIMER_MELODEE=y
# CONFIG_HAL_MULTICORE_FELUCCA is not set
# CONFIG_HAL_MULTICORE_SLOOP is not set
CONFIG_HAL_MULTICORE_MELODEE=y
CONFIG_HAL_MELODEE_CACHE=y
CONFIG_HAL_MELODEE_CLOCK=y
CONFIG_HAL_MELODEE_POWER=y
# end of HAL

#
# Boot
#
# CONFIG_BOOT_FELUCCA is not set
# CONFIG_BOOT_SLOOP is not set
CONFIG_BOOT_MELODEE=y
CONFIG_OTA=y
# end of Boot

#
# Audio
#
CONFIG_AUDIO=y
# CONFIG_DUAL_CORE is not set
# CONFIG_AUDIO_CORE_FELUCCA is not set
# CONFIG_AUDIO_CORE_SLOOP is not set
CONFIG_AUDIO_CORE_MELODEE=y
# CONFIG_AUDIO_24BIT is not set
# end of Audio

#
# MIDI
#
# CONFIG_MIDI_UART is not set
CONFIG_USB=y
# CONFIG_MIDI_FELUCCA is not set
# CONFIG_MIDI_SLOOP is not set
CONFIG_MIDI_MELODEE=y
CONFIG_USB_AUDIO=y
CONFIG_USB_AUDIO_HOST=y
CONFIG_USB_AUDIO_HOST_44K_16=y
CONFIG_USB_AUDIO_HOST_48K_24=y
CONFIG_USB_AUDIO_HOST_48K_32=y
CONFIG_USB_AUDIO_HOST_96K_24=y
# CONFIG_EDITOR is not set
# CONFIG_CONSOLE is not set
# end of MIDI

#
# UI
#
CONFIG_INPUT=y
CONFIG_LED_ANIM_FELUCCA=y
CONFIG_UI_SHELL_MODD=y
CONFIG_UI_SKIN_MODD=y
CONFIG_SPLASH_LOGO=y
# CONFIG_SPLASH_NONE is not set
# end of UI

#
# Storage
#
CONFIG_FLASH=y
# CONFIG_STORAGE_FELUCCA is not set
# CONFIG_STORAGE_SLOOP is not set
CONFIG_STORAGE_MELODEE=y
# end of Storage

#
# UDisk
#
CONFIG_USB_HOST=y
CONFIG_USB_HUB_MAX_DEVICES=12
CONFIG_UDISK=y
# end of UDisk

#
# Dock modules
#
# end of Dock modules

#
# BLE
#
# CONFIG_BLE is not set
# end of BLE

#
# Network
#
CONFIG_LWIP=y
CONFIG_USB_NET=y
CONFIG_USB_NET_AUTO=y
# end of Network

#
# WiFi
#
CONFIG_WIFI=y
CONFIG_WIFI_LWIP=y
CONFIG_WIFI_WPA=y
CONFIG_WIFI_SSID="Home"
CONFIG_WIFI_PASSWORD="fm1pass"
CONFIG_WIFI_DEFAULT_ON=y
CONFIG_WIFI_AUTOJOIN=y
# CONFIG_WIFI_MIDI is not set
CONFIG_WEATHER=y
CONFIG_WEATHER_LOCATION="40.7829,-73.9654,New York,US"
# CONFIG_WEATHER_UNIT_F is not set
CONFIG_WEATHER_HOST="api.open-meteo.com"
# CONFIG_LLM is not set
# CONFIG_WIFI_PROBES is not set
# end of WiFi

#
# RPC
#
CONFIG_RPC=y
CONFIG_RPC_PORT=9222
CONFIG_RPC_INPUT=y
CONFIG_RPC_MEM=y
CONFIG_RPC_AUDIO_TAP=y
# end of RPC

#
# Debug
#
CONFIG_DEBUG=y
CONFIG_DEBUG_LOG=y
CONFIG_DEBUG_LOG_LINES=400
CONFIG_DEBUG_DAP=y
CONFIG_DEBUG_FRAMEBUFFER=y
CONFIG_MIRROR=n
# end of Debug

#
# Settings Menu
#
CONFIG_SYS_MENU=y
CONFIG_SETTINGS_FMLAB=y
# CONFIG_SETTINGS_FELUCCA is not set
# CONFIG_SETTINGS_NONE is not set
CONFIG_SETTINGS_AT=0xFC000
CONFIG_SYS_MENU_MIDI_CH=y
CONFIG_SYS_MENU_NETWORK=y
CONFIG_SYS_MENU_HARDWARE=y
# end of Settings Menu

#
# Scheduler
#
CONFIG_SCHED=y
CONFIG_SCHED_MAX_TASKS=6
CONFIG_SCHED_STACK_CANARY=y
# end of Scheduler
# end of System
```

## configs/modd_felucca_defconfig
```kconfig
# modd_felucca: Felucca audio stack + modd LVGL shell with Felucca skin.
# Felucca core (params, mod, voice, slicer, fx, seq, audio included unchanged),
# effects, sequencer, scales, MIDI. FM6-Felucca engine, Felucca storage.
# All MIT engines + sample/slice/ADPCM. Melodee HAL, boot.
# modd_felucca_emu_defconfig is this plus the emulator hooks; keep the two in step.
#
CONFIG_CORE_FELUCCA=y
CONFIG_FIRMWARE_NAME="modd"
CONFIG_FIRMWARE_VERSION="v0.0.0"

#
# Engines
#
CONFIG_ENGINES=y

#
# Multi-upstream (require full audio core)
#
CONFIG_ENGINE_FM6=y
# CONFIG_ENGINE_FM6_FMLAB is not set
CONFIG_ENGINE_FM6_FELUCCA=y
# CONFIG_ENGINE_FM6_MELODEE is not set
# CONFIG_ENGINE_DRUM is not set

#
# Melodee
#
# CONFIG_ENGINE_PROPHET is not set
# CONFIG_ENGINE_CZ1 is not set
# CONFIG_ENGINE_SID is not set

#
# Felucca (MIT)
#
CONFIG_ENGINE_ANALOG=y
# CONFIG_ENGINE_DIGITAL is not set
CONFIG_ENGINE_PHASE=y
CONFIG_ENGINE_SAMPLE=y
CONFIG_ENGINE_GRANULAR=y
CONFIG_ENGINE_SLICE=y
CONFIG_ENGINE_ADPCM=y
CONFIG_ENGINE_LOFI=y
CONFIG_ENGINE_TRIO=y
CONFIG_ENGINE_TONEWHEEL=y
# CONFIG_ENGINE_FORMANT is not set
# CONFIG_ENGINE_PHYSICAL is not set
CONFIG_ENGINE_NOISE=y

#
# Development
#
CONFIG_ENGINE_STUB=y
# end of Engines

#
# Effects
#
CONFIG_EFFECTS_FELUCCA=y
# CONFIG_EFFECTS_SLOOP is not set
# CONFIG_EFFECTS_MELODEE is not set
CONFIG_MODULATION=y
CONFIG_MOD_FELUCCA=y
# CONFIG_MIX is not set
# end of Effects

#
# Sequencer
#
CONFIG_SEQ_FELUCCA=y
# CONFIG_SEQ_SLOOP is not set
# end of Sequencer

#
# Scales
#
CONFIG_SCALES_FELUCCA=y
# CONFIG_SCALES_MELODEE is not set
# end of Scales

#
# System
#

#
# HAL
#

#
# Always included: fm1_adc.h, fm1_cc.h, fm1_gpio.h, fm1_xip.h, fm1_time.h
#
# CONFIG_HAL_SYS_FELUCCA is not set
# CONFIG_HAL_SYS_SLOOP is not set
CONFIG_HAL_SYS_MELODEE=y
# CONFIG_HAL_IRQ_FELUCCA is not set
# CONFIG_HAL_IRQ_SLOOP is not set
CONFIG_HAL_IRQ_MELODEE=y
# CONFIG_HAL_LCD_FELUCCA is not set
CONFIG_HAL_LCD_MELODEE=y
# CONFIG_HAL_INPUT_FELUCCA is not set
# CONFIG_HAL_INPUT_SLOOP is not set
CONFIG_HAL_INPUT_MELODEE=y
# CONFIG_HAL_GUARD_FELUCCA is not set
# CONFIG_HAL_GUARD_SLOOP is not set
CONFIG_HAL_GUARD_MELODEE=y
# CONFIG_HAL_FLASH_FELUCCA is not set
# CONFIG_HAL_FLASH_SLOOP is not set
CONFIG_HAL_FLASH_MELODEE=y
# CONFIG_HAL_UART_FELUCCA is not set
CONFIG_HAL_UART_MELODEE=y
# CONFIG_HAL_USB_FELUCCA is not set
CONFIG_HAL_USB_MELODEE=y
# CONFIG_HAL_TIMER_FELUCCA is not set
CONFIG_HAL_TIMER_MELODEE=y
# CONFIG_HAL_MULTICORE_FELUCCA is not set
# CONFIG_HAL_MULTICORE_SLOOP is not set
CONFIG_HAL_MULTICORE_MELODEE=y
CONFIG_HAL_MELODEE_CACHE=y
CONFIG_HAL_MELODEE_CLOCK=y
CONFIG_HAL_MELODEE_POWER=y
# end of HAL

#
# Boot
#
# CONFIG_BOOT_FELUCCA is not set
# CONFIG_BOOT_SLOOP is not set
CONFIG_BOOT_MELODEE=y
CONFIG_OTA=y
# end of Boot

#
# Audio
#
CONFIG_AUDIO=y
# CONFIG_DUAL_CORE is not set
CONFIG_AUDIO_CORE_FELUCCA=y
# CONFIG_AUDIO_CORE_SLOOP is not set
# CONFIG_AUDIO_CORE_MELODEE is not set
# CONFIG_AUDIO_24BIT is not set
CONFIG_FELUCCA_DLY_LEN=32768
CONFIG_POOL_SIZE=0x52C00
# end of Audio

#
# MIDI
#
# CONFIG_MIDI_UART is not set
CONFIG_USB=y
CONFIG_MIDI_FELUCCA=y
# CONFIG_MIDI_SLOOP is not set
# CONFIG_MIDI_MELODEE is not set
CONFIG_USB_AUDIO=y
CONFIG_USB_AUDIO_HOST=y
CONFIG_USB_AUDIO_HOST_44K_16=y
CONFIG_USB_AUDIO_HOST_48K_24=y
CONFIG_USB_AUDIO_HOST_48K_32=y
CONFIG_USB_AUDIO_HOST_96K_24=y
# CONFIG_EDITOR is not set
# CONFIG_CONSOLE is not set
# end of MIDI

#
# UI
#
CONFIG_INPUT=y
CONFIG_LED_ANIM_FELUCCA=y
CONFIG_UI_SHELL_MODD=y
CONFIG_UI_SKIN_FELUCCA=y
CONFIG_SPLASH_LOGO=y
# CONFIG_SPLASH_NONE is not set
# end of UI

#
# Storage
#
CONFIG_FLASH=y
CONFIG_STORAGE_FELUCCA=y
# CONFIG_STORAGE_SLOOP is not set
# CONFIG_STORAGE_MELODEE is not set
# end of Storage

#
# UDisk
#
CONFIG_USB_HOST=y
CONFIG_USB_HUB_MAX_DEVICES=12
CONFIG_UDISK=y
# end of UDisk

#
# Dock modules
#
# end of Dock modules

#
# BLE
#
# CONFIG_BLE is not set
# end of BLE

#
# Network (disabled: Felucca upstream has no network stack)
#
# CONFIG_LWIP is not set
# CONFIG_USB_NET is not set
# end of Network

#
# WiFi (disabled: Felucca upstream has no WiFi)
#
# CONFIG_WIFI is not set
# end of WiFi

#
# RPC (requires LWIP, disabled on hardware)
#
# CONFIG_RPC is not set
# end of RPC

#
# Debug
#
CONFIG_DEBUG=y
CONFIG_DEBUG_LOG=y
CONFIG_DEBUG_LOG_LINES=400
CONFIG_DEBUG_DAP=y
# end of Debug

#
# Settings Menu
#
CONFIG_SYS_MENU=y
CONFIG_SETTINGS_FMLAB=y
# CONFIG_SETTINGS_FELUCCA is not set
# CONFIG_SETTINGS_NONE is not set
CONFIG_SETTINGS_AT=0xFC000
CONFIG_SYS_MENU_MIDI_CH=y
CONFIG_SYS_MENU_NETWORK=y
CONFIG_SYS_MENU_HARDWARE=y
# end of Settings Menu

#
# Scheduler
#
CONFIG_SCHED=y
CONFIG_SCHED_MAX_TASKS=6
CONFIG_SCHED_STACK_CANARY=y
# end of Scheduler
# end of System
```

## configs/modd_felucca_emu_defconfig
```kconfig
# modd_felucca_emu: emulator build of modd_felucca, never flashed.
# modd_felucca_defconfig plus CONFIG_EMU (expanded POOL linker script),
# CONFIG_DEBUG_FRAMEBUFFER, the REST API's input/memory/audio-tap routes,
# the emulator's test WiFi network, and the weather page with a fixed
# location. Keep in step with modd_felucca_defconfig.
#
CONFIG_EMU=y
CONFIG_FIRMWARE_NAME="modd"
CONFIG_FIRMWARE_VERSION="v0.0.0"

#
# Engines
#
CONFIG_ENGINES=y

#
# Multi-upstream (require full audio core)
#
CONFIG_ENGINE_FM6=y
CONFIG_ENGINE_FM6_FMLAB=y
# CONFIG_ENGINE_FM6_FELUCCA is not set
# CONFIG_ENGINE_FM6_MELODEE is not set
# CONFIG_ENGINE_DRUM is not set

#
# Melodee
#
# CONFIG_ENGINE_PROPHET is not set
# CONFIG_ENGINE_CZ1 is not set
# CONFIG_ENGINE_SID is not set

#
# Felucca (MIT)
#
CONFIG_ENGINE_ANALOG=y
# CONFIG_ENGINE_DIGITAL is not set
CONFIG_ENGINE_PHASE=y
# CONFIG_ENGINE_SAMPLE is not set
# CONFIG_ENGINE_GRANULAR is not set
CONFIG_ENGINE_LOFI=y
CONFIG_ENGINE_TRIO=y
CONFIG_ENGINE_TONEWHEEL=y
# CONFIG_ENGINE_FORMANT is not set
# CONFIG_ENGINE_PHYSICAL is not set
CONFIG_ENGINE_NOISE=y

#
# Development
#
CONFIG_ENGINE_STUB=y
# end of Engines

#
# Effects
#
CONFIG_EFFECTS_FELUCCA=y
# CONFIG_EFFECTS_SLOOP is not set
# CONFIG_EFFECTS_MELODEE is not set
# CONFIG_MODULATION is not set
# CONFIG_MIX is not set
# end of Effects

#
# Sequencer
#
CONFIG_SEQ_FELUCCA=y
# CONFIG_SEQ_SLOOP is not set
# CONFIG_SEQ_MELODEE is not set
# end of Sequencer

#
# Scales
#
CONFIG_SCALES_FELUCCA=y
# CONFIG_SCALES_MELODEE is not set
# end of Scales

#
# System
#

#
# HAL
#

#
# Always included: fm1_adc.h, fm1_cc.h, fm1_gpio.h, fm1_xip.h, fm1_time.h
#
# CONFIG_HAL_SYS_FELUCCA is not set
# CONFIG_HAL_SYS_SLOOP is not set
CONFIG_HAL_SYS_MELODEE=y
# CONFIG_HAL_IRQ_FELUCCA is not set
# CONFIG_HAL_IRQ_SLOOP is not set
CONFIG_HAL_IRQ_MELODEE=y
# CONFIG_HAL_LCD_FELUCCA is not set
CONFIG_HAL_LCD_MELODEE=y
# CONFIG_HAL_INPUT_FELUCCA is not set
# CONFIG_HAL_INPUT_SLOOP is not set
CONFIG_HAL_INPUT_MELODEE=y
# CONFIG_HAL_GUARD_FELUCCA is not set
# CONFIG_HAL_GUARD_SLOOP is not set
CONFIG_HAL_GUARD_MELODEE=y
# CONFIG_HAL_FLASH_FELUCCA is not set
# CONFIG_HAL_FLASH_SLOOP is not set
CONFIG_HAL_FLASH_MELODEE=y
# CONFIG_HAL_UART_FELUCCA is not set
CONFIG_HAL_UART_MELODEE=y
# CONFIG_HAL_USB_FELUCCA is not set
CONFIG_HAL_USB_MELODEE=y
# CONFIG_HAL_TIMER_FELUCCA is not set
CONFIG_HAL_TIMER_MELODEE=y
# CONFIG_HAL_MULTICORE_FELUCCA is not set
# CONFIG_HAL_MULTICORE_SLOOP is not set
CONFIG_HAL_MULTICORE_MELODEE=y
CONFIG_HAL_MELODEE_CACHE=y
CONFIG_HAL_MELODEE_CLOCK=y
CONFIG_HAL_MELODEE_POWER=y
# end of HAL

#
# Boot
#
# CONFIG_BOOT_FELUCCA is not set
# CONFIG_BOOT_SLOOP is not set
CONFIG_BOOT_MELODEE=y
CONFIG_OTA=y
# end of Boot

#
# Audio
#
CONFIG_AUDIO=y
# CONFIG_DUAL_CORE is not set
CONFIG_AUDIO_CORE_FELUCCA=y
# CONFIG_AUDIO_CORE_SLOOP is not set
# CONFIG_AUDIO_CORE_MELODEE is not set
# CONFIG_AUDIO_24BIT is not set
# end of Audio

#
# MIDI
#
# CONFIG_MIDI_UART is not set
CONFIG_USB=y
CONFIG_MIDI_FELUCCA=y
# CONFIG_MIDI_SLOOP is not set
# CONFIG_MIDI_MELODEE is not set
CONFIG_USB_AUDIO=y
CONFIG_USB_AUDIO_HOST=y
# CONFIG_EDITOR is not set
# CONFIG_CONSOLE is not set
# end of MIDI

#
# UI
#
CONFIG_INPUT=y
# CONFIG_UI_THEME_FELUCCA_UPSTREAM is not set
CONFIG_UI_THEME_MODD=y
CONFIG_SPLASH_LOGO=y
# CONFIG_SPLASH_NONE is not set
# end of UI

#
# Storage
#
CONFIG_FLASH=y
# CONFIG_STORAGE_FELUCCA is not set
# CONFIG_STORAGE_SLOOP is not set
CONFIG_STORAGE_MELODEE=y
# end of Storage

#
# UDisk
#
CONFIG_USB_HOST=y
CONFIG_USB_HUB_MAX_DEVICES=12
CONFIG_UDISK=y
# end of UDisk

#
# Dock modules
#
# CONFIG_DOCK is not set
# end of Dock modules

#
# BLE
#
# CONFIG_BLE is not set
# end of BLE

#
# Network (LWIP for RPC/API tests; no WiFi)
#
CONFIG_LWIP=y
CONFIG_USB_NET=y
CONFIG_USB_NET_AUTO=y
# end of Network

#
# WiFi (disabled: Felucca upstream has no WiFi)
#
# CONFIG_WIFI is not set
CONFIG_WEATHER=y
CONFIG_WEATHER_LOCATION="40.7829,-73.9654,New York,US"
# CONFIG_WEATHER_UNIT_F is not set
CONFIG_WEATHER_HOST="api.open-meteo.com"
# CONFIG_LLM is not set
# end of WiFi

#
# RPC
#
CONFIG_RPC=y
CONFIG_RPC_PORT=9222
CONFIG_RPC_INPUT=y
CONFIG_RPC_MEM=y
CONFIG_RPC_AUDIO_TAP=y
# end of RPC

#
# Debug
#
CONFIG_DEBUG=y
CONFIG_DEBUG_LOG=y
CONFIG_DEBUG_LOG_LINES=400
CONFIG_DEBUG_DAP=y
CONFIG_DEBUG_FRAMEBUFFER=y
# end of Debug

#
# Settings Menu
#
CONFIG_SYS_MENU=y
CONFIG_SETTINGS_FMLAB=y
# CONFIG_SETTINGS_FELUCCA is not set
# CONFIG_SETTINGS_NONE is not set
CONFIG_SETTINGS_AT=0xFC000
CONFIG_SYS_MENU_MIDI_CH=y
CONFIG_SYS_MENU_NETWORK=y
CONFIG_SYS_MENU_HARDWARE=y
# end of Settings Menu

#
# Scheduler
#
CONFIG_SCHED=y
CONFIG_SCHED_MAX_TASKS=6
CONFIG_SCHED_STACK_CANARY=y
# end of Scheduler
# end of System
```
